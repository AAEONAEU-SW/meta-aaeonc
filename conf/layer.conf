## conf/layer.conf
```bitbake
# We have a conf and classes directory, add to BBPATH
BBPATH .= ":${LAYERDIR}"

# We have recipes-* directories, add to BBFILES
BBFILES += "${LAYERDIR}/recipes-*/*/*.bb \
            ${LAYERDIR}/recipes-*/*/*.bbappend"

BBFILE_COLLECTIONS += "aaeonc"
BBFILE_PATTERN_aaeonc = "^${LAYERDIR}/"
BBFILE_PRIORITY_aaeonc = "6"

LAYERDEPENDS_aaeonc = "intel"

LAYERSERIES_COMPAT_aaeonc = "sumo"
```

## conf/machine/aaeonc.conf
```bitbake
#@TYPE: Machine
#@NAME: aaeonc

#@DESCRIPTION: Machine configuration for aaeon community systems

PREFERRED_PROVIDER_virtual/kernel ?= "linux-yocto"
PREFERRED_PROVIDER_virtual/kernel_poky-tiny ?= "linux-yocto"
PREFERRED_PROVIDER_virtual/kernel_linuxstdbase ?= "linux-yocto"
PREFERRED_VERSION_linux-yocto ?= "4.9%"

require conf/machine/intel-corei7-64.conf

MACHINE_EXTRA_RRECOMMENDS += "linux-firmware v86d eee-acpi-scripts"

EXTRA_OECONF_append_pn-matchbox-panel-2 = " --with-battery=acpi"

GLIBC_ADDONS = "nptl"

SERIAL_CONSOLES = "115200;ttyS0"

KERNEL_MODULE_AUTOLOAD += "f71882fg"
KERNEL_MODULE_AUTOLOAD += "i2c-i801"
```
